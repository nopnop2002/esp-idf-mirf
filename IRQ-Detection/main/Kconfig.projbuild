## IRQ-Detection/main/Kconfig.projbuild
```kconfig
menu "Application Configuration"

	config GPIO_RANGE_MAX
		int
		default 33 if IDF_TARGET_ESP32
		default 46 if IDF_TARGET_ESP32S2
		default 48 if IDF_TARGET_ESP32S3
		default 18 if IDF_TARGET_ESP32C2
		default 19 if IDF_TARGET_ESP32C3
		default 30 if IDF_TARGET_ESP32C6

	choice DIRECTION
		prompt "Communication polarity"
		default SENDER
		help
			Select Communication polarity.
		config SENDER
			bool "As the sender"
			help
				As the sender.
		config RECEIVER
			bool "As the receiver"
			help
				As the receiver.
	endchoice

	config IRQ_GPIO
		int "IRQ GPIO number"
		range 0 GPIO_RANGE_MAX
		default 15 if IDF_TARGET_ESP32
		default 38 if IDF_TARGET_ESP32S2 || IDF_TARGET_ESP32S3
		default  5 # C3 and others
		help
			GPIO number (IOxx) to IRQ.
			Some GPIOs are used for other purposes (flash connections, etc.) and cannot be used to MISO.
			On the ESP32, GPIOs 35-39 are input-only so cannot be used as outputs.
			On the ESP32-S2, GPIO 46 is input-only so cannot be used as outputs.

endmenu 
```

## Multiple-Receive/main/Kconfig.projbuild
```kconfig
menu "Application Configuration"

    choice DIRECTION
        prompt "Communication polarity"
        default RECEIVER
        help
            Select Communication polarity.
        config SENDER
            bool "As the sender"
            help
                As the sender.
        config RECEIVER
            bool "As the receiver"
            help
                As the receiver.
    endchoice

	choice TADDR
		prompt "Sender's address"
		depends on SENDER
		default TADDR1
		help
			Select sender's address.
		config TADDR1
			bool "Use 1 as sender's address"
			help
				Use 1 as sender's address
		config TADDR2
			bool "Use 2 as sender's address"
			help
				Use 2 as sender's address
		config TADDR3
			bool "Use 3 as sender's address"
			help
				Use 3 as sender's address
		config TADDR4
			bool "Use 4 as sender's address"
			help
				Use 4 as sender's address
		config TADDR5
			bool "Use 5 as sender's address"
			help
				Use 5 as sender's address

	endchoice

endmenu 
```

## Multiple-Send/main/Kconfig.projbuild
```kconfig
menu "Application Configuration"

	choice DIRECTION
		prompt "Communication polarity"
		default SENDER
		help
			Select Communication polarity.
		config SENDER
			bool "As the sender"
			help
				As the sender.
		config RECEIVER
			bool "As the receiver"
			help
				As the receiver.
	endchoice

	choice RADDR
		prompt "Receiver's address"
		depends on RECEIVER
		default RADDR1
		help
			Select receiver's address.
		config RADDR1
			bool "Use 11111 as receiver's address"
			help
				Use 11111 as receiver's address
		config RADDR2
			bool "Use 22222 as receiver's address"
			help
				Use 22222 as receiver's address
	endchoice

endmenu 
```

## Peer-to-peer/main/Kconfig.projbuild
```kconfig
menu "Application Configuration"

	choice DIRECTION
		prompt "Communication direction"
		default RECEIVER
		help
			Select Communication direction.
		config RECEIVER
			bool "Receiver"
			help
				Execute Receiver.
		config TRANSMITTER
			bool "Transmitter"
			help
				Execute Transmitter.
	endchoice

	config ADVANCED
		bool "Enable Advanced Setting"
		default false
		help
			Enable Advanced Setting.

	choice RF_RATIO
		depends on ADVANCED
		prompt "RF Data Ratio"
		default RF_RATIO_2M
		help
			Select RF Data Ratio.
		config RF_RATIO_2M
			bool "2Mbps"
			help
				RF Data Ratio is 2Mbps.
		config RF_RATIO_1M
			bool "1Mbps"
			help
				RF Data Ratio is 1Mbps.
		config RF_RATIO_250K
			bool "250Kbps"
			help
				RF Data Ratio is 250Kbps.
	endchoice

	config RETRANSMIT_DELAY
		depends on ADVANCED
		int "Auto Retransmit Delay"
		range 0 15
		default 0
		help
			Set Auto Retransmit Delay.
			Delay = value * 250us.

endmenu 
```

## components/mirf/Kconfig.projbuild
```kconfig
menu "nRF24L01 Configuration"

	config GPIO_RANGE_MAX
		int
		default 33 if IDF_TARGET_ESP32
		default 46 if IDF_TARGET_ESP32S2
		default 48 if IDF_TARGET_ESP32S3
		default 18 if IDF_TARGET_ESP32C2
		default 19 if IDF_TARGET_ESP32C3

	config MISO_GPIO
		int "MISO GPIO number"
		range 0 GPIO_RANGE_MAX
		default 19 if IDF_TARGET_ESP32
		default 37 if IDF_TARGET_ESP32S2 || IDF_TARGET_ESP32S3
		default  4 if IDF_TARGET_ESP32C3 || IDF_TARGET_ESP32C2
		help
			GPIO number (IOxx) to SPI MISO.
			Some GPIOs are used for other purposes (flash connections, etc.) and cannot be used to MISO.
			On the ESP32, GPIOs 35-39 are input-only so cannot be used as outputs.
			On the ESP32-S2, GPIO 46 is input-only so cannot be used as outputs.

	config SCLK_GPIO
		int "SCLK GPIO number"
		range 0 GPIO_RANGE_MAX
		default 18 if IDF_TARGET_ESP32
		default 36 if IDF_TARGET_ESP32S2 || IDF_TARGET_ESP32S3
		default  3 if IDF_TARGET_ESP32C3 || IDF_TARGET_ESP32C2
		help
			GPIO number (IOxx) to SPI SCLK.
			Some GPIOs are used for other purposes (flash connections, etc.) and cannot be used to SCLK.
			On the ESP32, GPIOs 35-39 are input-only so cannot be used as outputs.
			On the ESP32-S2, GPIO 46 is input-only so cannot be used as outputs.

	config MOSI_GPIO
		int "MOSI GPIO number"
		range 0 GPIO_RANGE_MAX
		default 23 if IDF_TARGET_ESP32
		default 35 if IDF_TARGET_ESP32S2 || IDF_TARGET_ESP32S3
		default  2 if IDF_TARGET_ESP32C3 || IDF_TARGET_ESP32C2
		help
			GPIO number (IOxx) to SPI MOSI.
			Some GPIOs are used for other purposes (flash connections, etc.) and cannot be used to MOSI.
			On the ESP32, GPIOs 35-39 are input-only so cannot be used as outputs.
			On the ESP32-S2, GPIO 46 is input-only so cannot be used as outputs.

	config CE_GPIO
		int "CE GPIO number"
		range 0 GPIO_RANGE_MAX
		default 16 if IDF_TARGET_ESP32
		default 34 if IDF_TARGET_ESP32S2 || IDF_TARGET_ESP32S3
		default  1 if IDF_TARGET_ESP32C3 || IDF_TARGET_ESP32C2
		help
			GPIO number (IOxx) to CE.
			Some GPIOs are used for other purposes (flash connections, etc.) and cannot be used to CE.
			On the ESP32, GPIOs 35-39 are input-only so cannot be used as outputs.
			On the ESP32-S2, GPIO 46 is input-only so cannot be used as outputs.

	config CSN_GPIO
		int "CSN GPIO number"
		range 0 GPIO_RANGE_MAX
		default 17 if IDF_TARGET_ESP32
		default 33 if IDF_TARGET_ESP32S2 || IDF_TARGET_ESP32S3
		default  0 if IDF_TARGET_ESP32C3 || IDF_TARGET_ESP32C2
		help
			GPIO number (IOxx) to CSN.
			Some GPIOs are used for other purposes (flash connections, etc.) and cannot be used to CSN.
			On the ESP32, GPIOs 35-39 are input-only so cannot be used as outputs.
			On the ESP32-S2, GPIO 46 is input-only so cannot be used as outputs.

	choice SPI_HOST
		prompt "SPI peripheral that controls this bus"
		default SPI2_HOST
		help
			Select SPI peripheral that controls this bus.
		config SPI2_HOST
			bool "SPI2_HOST"
			help
				Use SPI2_HOST. This is also called HSPI_HOST.
		config SPI3_HOST
			depends on IDF_TARGET_ESP32 || IDF_TARGET_ESP32S2 || IDF_TARGET_ESP32S3
			bool "SPI3_HOST"
			help
				USE SPI3_HOST. This is also called VSPI_HOST
	endchoice

endmenu 
```

## main/Kconfig.projbuild
```kconfig
menu "nRF24L01 Configuration"

	config MISO_GPIO
		int "MISO GPIO number"
		range 0 46
		default 19 if IDF_TARGET_ESP32
		default 33 if IDF_TARGET_ESP32S2
		default 18 if IDF_TARGET_ESP32C3
		help
			GPIO number (IOxx) to SPI MISO.
			Some GPIOs are used for other purposes (flash connections, etc.) and cannot be used to MISO.
			On the ESP32, GPIOs 35-39 are input-only so cannot be used as outputs.
			On the ESP32-S2, GPIO 46 is input-only so cannot be used as outputs.

	config MOSI_GPIO
		int "MOSI GPIO number"
		range 0 46
		default 23 if IDF_TARGET_ESP32
		default 35 if IDF_TARGET_ESP32S2
		default 19 if IDF_TARGET_ESP32C3
		help
			GPIO number (IOxx) to SPI MOSI.
			Some GPIOs are used for other purposes (flash connections, etc.) and cannot be used to MOSI.
			On the ESP32, GPIOs 35-39 are input-only so cannot be used as outputs.
			On the ESP32-S2, GPIO 46 is input-only so cannot be used as outputs.

	config SCLK_GPIO
		int "SCLK GPIO number"
		range 0 46
		default 18 if IDF_TARGET_ESP32
		default 36 if IDF_TARGET_ESP32S2
		default 10 if IDF_TARGET_ESP32C3
		help
			GPIO number (IOxx) to SPI SCLK.
			Some GPIOs are used for other purposes (flash connections, etc.) and cannot be used to SCLK.
			On the ESP32, GPIOs 35-39 are input-only so cannot be used as outputs.
			On the ESP32-S2, GPIO 46 is input-only so cannot be used as outputs.

	config CE_GPIO
		int "CE GPIO number"
		range 0 46
		default 16 if IDF_TARGET_ESP32
		default 37 if IDF_TARGET_ESP32S2
		default 9  if IDF_TARGET_ESP32C3
		help
			GPIO number (IOxx) to CE.
			Some GPIOs are used for other purposes (flash connections, etc.) and cannot be used to CE.
			On the ESP32, GPIOs 35-39 are input-only so cannot be used as outputs.
			On the ESP32-S2, GPIO 46 is input-only so cannot be used as outputs.

	config CSN_GPIO
		int "CSN GPIO number"
		range 0 46
		default 17 if IDF_TARGET_ESP32
		default 38 if IDF_TARGET_ESP32S2
		default 8  if IDF_TARGET_ESP32C3
		help
			GPIO number (IOxx) to CSN.
			Some GPIOs are used for other purposes (flash connections, etc.) and cannot be used to CSN.
			On the ESP32, GPIOs 35-39 are input-only so cannot be used as outputs.
			On the ESP32-S2, GPIO 46 is input-only so cannot be used as outputs.

	choice DIRECTION
		prompt "Communication direction"
		default Receiver
		help
			Select Communication direction.
		config RECEIVER
			bool "Receiver"
			help
				Execute Receiver.
		config TRANSMITTER
			bool "Transmitter"
			help
				Execute Transmitter.
	endchoice

endmenu 
```

## mqtt/main/Kconfig.projbuild
```kconfig
menu "Application Configuration"

	menu "WiFi Setting"

		config ESP_WIFI_SSID
			string "WiFi SSID"
			default "myssid"
			help
				SSID (network name) to connect to.

		config ESP_WIFI_PASSWORD
			string "WiFi Password"
			default "mypassword"
			help
				WiFi password (WPA or WPA2) to connect to.

		config ESP_MAXIMUM_RETRY
			int "Maximum retry"
			default 5
			help
				Set the Maximum retry to avoid station reconnecting to the AP unlimited when the AP is really inexistent.

	endmenu

	menu "Radio Setting"

		choice DIRECTION
			prompt "Communication direction"
			default RADIO_TO_MQTT
			help
				Select Communication direction.
			config RADIO_TO_MQTT
				bool "Receive from radio and send by MQTT"
				help
					Receive from radio and send by MQTT.
			config MQTT_TO_RADIO
				bool "Receive from MQTT and send by radio"
				help
					Receive from MQTT and send by radio
		endchoice

		config PAYLOAD_SIZE
			int "Payload size (byte)"
			range 1 32
			default 32
			help
				Payload size.

		config RECEIVER_ADDRESS
			depends on RADIO_TO_MQTT
			string "My address"
			default "FGHIJ"
			help
				My address.

		config DESTINATION_ADDRESS
			depends on MQTT_TO_RADIO
			string "Destination address"
			default "FGHIJ"
			help
				Destination address.

		config RADIO_CHANNEL
			int "Radio channel to use"
			range 1 127
			default 90
			help
				Radio channel to use.

		config MQTT_BROKER
			string "MQTT Broker"
			default "broker.emqx.io"
			help
				Host name or IP address of the broker to connect to

		config MQTT_PUB_TOPIC
			depends on RADIO_TO_MQTT
			string "Publish Topic"
			default "/topic/mirf/test"
			help
				Topic of publish

		config MQTT_SUB_TOPIC
			depends on MQTT_TO_RADIO
			string "Subscribe Topic"
			default "/topic/mirf/test"
			help
				Topic of subscribe

	endmenu

endmenu 
```
